## conf/layer.conf
```bitbake
# We have a conf and classes directory, append to BBPATH
BBPATH .= ":${LAYERDIR}"

BBFILES += "${LAYERDIR}/recipes*/*/*.bb ${LAYERDIR}/recipes*/*/*.bbappend ${LAYERDIR}/images/*.bb"

BBFILE_COLLECTIONS += "meta-wandboard"
BBFILE_PATTERN_meta-wandboard := "^${LAYERDIR}/"
BBFILE_PRIORITY_meta-wandboard = "16"

LAYERSERIES_COMPAT_meta-wandboard = "gatesgarth"
```

## conf/machine/wandboard.conf
```bitbake
#@TYPE: Machine
#@NAME: wandboard 
#@DESCRIPTION: Machine configuration for the wandboard 

SOC_FAMILY = "mx6:mx6q:wandboard"
TARGET_ARCH = "arm"

DEFAULTTUNE ?= "cortexa9hf-neon"

include conf/machine/include/soc-family.inc
include conf/machine/include/arm/armv7a/tune-cortexa9.inc

PREFERRED_PROVIDER_virtual/kernel = "linux-stable"
KERNEL_IMAGETYPE = "zImage"

PREFERRED_PROVIDER_virtual/bootloader = "u-boot"
PREFERRED_PROVIDER_u-boot = "u-boot"

UBOOT_MACHINE = "wandboard_config"
BOOTENV_SIZE = "0x20000"
UBOOT_SUFFIX = "img"
SPL_BINARY = "SPL"

EXTRA_IMAGEDEPENDS += "u-boot"

SERIAL_CONSOLES = "115200;ttymxc0"

IMAGE_FSTYPES = "tar.xz ext4 wic.bz2 wic.bmap"

MACHINE_ESSENTIAL_EXTRA_RDEPENDS = "kernel-image kernel-devicetree kernel-modules"

MACHINE_FEATURES = "ext2 serial usbhost vfat"

WKS_FILE ?= "wandboard.wks.in"
```
